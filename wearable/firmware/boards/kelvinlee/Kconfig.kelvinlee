## wearable/firmware/boards/kelvinlee/Kconfig.kelvinlee
```kconfig
config BOARD_KELVINLEE
	select SOC_NRF5340_CPUAPP_QKAA if BOARD_KELVINLEE_NRF5340_CPUAPP
	select SOC_NRF5340_CPUAPP_QKAA if BOARD_KELVINLEE_NRF5340_CPUAPP_NS
	select SOC_NRF5340_CPUNET_QKAA if BOARD_KELVINLEE_NRF5340_CPUNET
```

## wearable/firmware/boards/kelvinlee/board.yml
```yaml
# Copyright (c) 2025-2026 Kelvin Lee. Licensed under MIT. Portions (c) 2024 Based Hardware Contributors, MIT (see LICENSE-UPSTREAM).

board:
  name: kelvinlee
  vendor: kelvinlee
  socs:
  - name: nrf5340
    variants:
    - name: ns
      cpucluster: cpuapp
```

## wearable/firmware/kelvinlee/Kconfig
```kconfig
source "Kconfig.zephyr"

menu "KelvinLee Features Configuration"

config KELVINLEE_CODEC_OPUS
    bool "Opus Audio Codec"
    help
        "Enable the Opus audio codec support."
    default n

config KELVINLEE_ENABLE_OFFLINE_STORAGE
	bool "Offline SD Card Storage"
    help
        "Enable the offline storage support. Requires a SD Card."
	default n

config KELVINLEE_ENABLE_ACCELEROMETER
    bool "Accelerometer Support"
    help
        "Enable the accelerometer support."
    default n

config KELVINLEE_ENABLE_BUTTON
    bool "Button support"
    help
        "Enable the software button support."
    default n

config KELVINLEE_ENABLE_SPEAKER
    bool "Enable the speaker"
    help
        "Enable the speaker support."
    default n

config KELVINLEE_ENABLE_BATTERY
    bool "Enable the battery"
    help
        "Enable the battery support."
    default n

config KELVINLEE_ENABLE_USB
    bool "Enable the usb"
    help
        "Enable the USB power check support."
    default n

config KELVINLEE_ENABLE_HAPTIC
    bool "Enable the haptic"
    help
        "Enable the haptic support."
    default n

config KELVINLEE_ENABLE_RFSW_CTRL
    bool "Enable RFSwitch Control"
    help
        "Enable RFSwitch Control support."
    default y

endmenu
```
