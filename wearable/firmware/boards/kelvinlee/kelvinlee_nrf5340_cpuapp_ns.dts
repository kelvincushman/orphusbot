# Copyright (c) 2025-2026 Kelvin Lee. Licensed under MIT. Portions (c) 2024 Based Hardware Contributors, MIT (see LICENSE-UPSTREAM).

/dts-v1/;
#include <nordic/nrf5340_cpuappns_qkaa.dtsi>
#include "kelvinlee-pinctrl.dtsi"

/ {
	model = "Custom Board auto generated by nRF Connect for VS Code (CPUAPP Non-Secure)";
	compatible = "kelvinlee,kelvinlee-cpuapp-ns";

	chosen {
		zephyr,sram = &sram0_ns;
		zephyr,flash = &flash0;
		zephyr,code-partition = &slot0_ns_partition;
		zephyr,bt-hci = &bt_hci_ipc0;
		nordic,802154-spinel-ipc = &ipc0;
	};
};

#include "kelvinlee-cpuapp_partitioning.dtsi"
#include "kelvinlee-shared_sram.dtsi"
