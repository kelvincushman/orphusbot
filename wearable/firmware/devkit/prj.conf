## CMakeLists.txt
```
# SPDX-License-Identifier: Apache-2.0
cmake_minimum_required(VERSION 3.20.0)
find_package(Zephyr REQUIRED HINTS $ENV{ZEPHYR_BASE})
project(nrf52840_nordic)
enable_language(C ASM)

target_sources(app PRIVATE
    src/main.c
    src/transport.c
    src/mic.c
    src/led.c
    src/codec.c
    src/lib/battery/battery.c
    src/button.c
    src/haptic.c
    src/sdcard.c
    src/storage.c
    src/usb.c
    # Wearable additions — NeoPixel + agent-commands GATT (0xCAB1AB97) + habitat feedback.
    src/neopixel.c
    src/agent_commands.c
    src/habitat.c
	# src/nfc.c future release
)

target_sources_ifdef(CONFIG_KELVINLEE_CODEC_OPUS app PRIVATE
    src/lib/opus-1.2.1/A2NLSF.c
    src/lib/opus-1.2.1/CNG.c
    src/lib/opus-1.2.1/HP_variable_cutoff.c
    src/lib/opus-1.2.1/LPC_analysis_filter.c
    src/lib/opus-1.2.1/LPC_fit.c
    src/lib/opus-1.2.1/LPC_inv_pred_gain.c
    src/lib/opus-1.2.1/LP_variable_cutoff.c
    src/lib/opus-1.2.1/LTP_analysis_filter_FIX.c
    src/lib/opus-1.2.1/LTP_scale_ctrl_FIX.c
    src/lib/opus-1.2.1/NLSF2A.c
    src/lib/opus-1.2.1/NLSF_VQ.c
    src/lib/opus-1.2.1/NLSF_VQ_weights_laroia.c
    src/lib/opus-1.2.1/NLSF_decode.c
    src/lib/opus-1.2.1/NLSF_del_dec_quant.c
    src/lib/opus-1.2.1/NLSF_encode.c
    src/lib/opus-1.2.1/NLSF_stabilize.c
    src/lib/opus-1.2.1/NLSF_unpack.c
    src/lib/opus-1.2.1/NSQ.c
    src/lib/opus-1.2.1/NSQ_del_dec.c
    src/lib/opus-1.2.1/PLC.c
    src/lib/opus-1.2.1/VAD.c
    src/lib/opus-1.2.1/VQ_WMat_EC.c
    src/lib/opus-1.2.1/ana_filt_bank_1.c
    src/lib/opus-1.2.1/analysis.c
    src/lib/opus-1.2.1/apply_sine_window_FIX.c
    src/lib/opus-1.2.1/autocorr_FIX.c
    src/lib/opus-1.2.1/bands.c
    src/lib/opus-1.2.1/biquad_alt.c
    src/lib/opus-1.2.1/burg_modified_FIX.c
    src/lib/opus-1.2.1/bwexpander.c
    src/lib/opus-1.2.1/bwexpander_32.c
    src/lib/opus-1.2.1/celt.c
    src/lib/opus-1.2.1/celt_decoder.c
    src/lib/opus-1.2.1/celt_encoder.c
    src/lib/opus-1.2.1/celt_lpc.c
    src/lib/opus-1.2.1/arm/celt_pitch_xcorr_arm_gcc.s
    src/lib/opus-1.2.1/check_control_input.c
    src/lib/opus-1.2.1/code_signs.c
    src/lib/opus-1.2.1/control_SNR.c
    src/lib/opus-1.2.1/control_audio_bandwidth.c
    src/lib/opus-1.2.1/control_codec.c
    src/lib/opus-1.2.1/corrMatrix_FIX.c
    src/lib/opus-1.2.1/cwrs.c
    src/lib/opus-1.2.1/debug.c
    src/lib/opus-1.2.1/dec_API.c
    src/lib/opus-1.2.1/decode_core.c
    src/lib/opus-1.2.1/decode_frame.c
    src/lib/opus-1.2.1/decode_indices.c
    src/lib/opus-1.2.1/decode_parameters.c
    src/lib/opus-1.2.1/decode_pitch.c
    src/lib/opus-1.2.1/decode_pulses.c
    src/lib/opus-1.2.1/decoder_set_fs.c
    src/lib/opus-1.2.1/enc_API.c
    src/lib/opus-1.2.1/encode_frame_FIX.c
    src/lib/opus-1.2.1/encode_indices.c
    src/lib/opus-1.2.1/encode_pulses.c
    src/lib/opus-1.2.1/entcode.c
    src/lib/opus-1.2.1/entdec.c
    src/lib/opus-1.2.1/entenc.c
    src/lib/opus-1.2.1/find_LPC_FIX.c
    src/lib/opus-1.2.1/find_LTP_FIX.c
    src/lib/opus-1.2.1/find_pitch_lags_FIX.c
    src/lib/opus-1.2.1/find_pred_coefs_FIX.c
    src/lib/opus-1.2.1/gain_quant.c
    src/lib/opus-1.2.1/init_decoder.c
    src/lib/opus-1.2.1/init_encoder.c
    src/lib/opus-1.2.1/inner_prod_aligned.c
    src/lib/opus-1.2.1/interpolate.c
    src/lib/opus-1.2.1/k2a_FIX.c
    src/lib/opus-1.2.1/k2a_Q16_FIX.c
    src/lib/opus-1.2.1/kiss_fft.c
    src/lib/opus-1.2.1/laplace.c
    src/lib/opus-1.2.1/lin2log.c
    src/lib/opus-1.2.1/log2lin.c
    src/lib/opus-1.2.1/mathops.c
    src/lib/opus-1.2.1/mdct.c
    src/lib/opus-1.2.1/mlp.c
    src/lib/opus-1.2.1/mlp_data.c
    src/lib/opus-1.2.1/modes.c
    src/lib/opus-1.2.1/noise_shape_analysis_FIX.c
    src/lib/opus-1.2.1/opus.c
    src/lib/opus-1.2.1/opus_decoder.c
    src/lib/opus-1.2.1/opus_encoder.c
    src/lib/opus-1.2.1/opus_multistream.c
    src/lib/opus-1.2.1/opus_multistream_decoder.c
    src/lib/opus-1.2.1/opus_multistream_encoder.c
    src/lib/opus-1.2.1/pitch.c
    src/lib/opus-1.2.1/pitch_analysis_core_FIX.c
    src/lib/opus-1.2.1/pitch_est_tables.c
    src/lib/opus-1.2.1/process_NLSFs.c
    src/lib/opus-1.2.1/process_gains_FIX.c
    src/lib/opus-1.2.1/quant_LTP_gains.c
    src/lib/opus-1.2.1/quant_bands.c
    src/lib/opus-1.2.1/rate.c
    src/lib/opus-1.2.1/regularize_correlations_FIX.c
    src/lib/opus-1.2.1/repacketizer.c
    src/lib/opus-1.2.1/resampler.c
    src/lib/opus-1.2.1/resampler_down2.c
    src/lib/opus-1.2.1/resampler_down2_3.c
    src/lib/opus-1.2.1/resampler_private_AR2.c
    src/lib/opus-1.2.1/resampler_private_IIR_FIR.c
    src/lib/opus-1.2.1/resampler_private_down_FIR.c
    src/lib/opus-1.2.1/resampler_private_up2_HQ.c
    src/lib/opus-1.2.1/resampler_rom.c
    src/lib/opus-1.2.1/residual_energy16_FIX.c
    src/lib/opus-1.2.1/residual_energy_FIX.c
    src/lib/opus-1.2.1/schur64_FIX.c
    src/lib/opus-1.2.1/schur_FIX.c
    src/lib/opus-1.2.1/shell_coder.c
    src/lib/opus-1.2.1/sigm_Q15.c
    src/lib/opus-1.2.1/sort.c
    src/lib/opus-1.2.1/stereo_LR_to_MS.c
    src/lib/opus-1.2.1/stereo_MS_to_LR.c
    src/lib/opus-1.2.1/stereo_decode_pred.c
    src/lib/opus-1.2.1/stereo_encode_pred.c
    src/lib/opus-1.2.1/stereo_find_predictor.c
    src/lib/opus-1.2.1/stereo_quant_pred.c
    src/lib/opus-1.2.1/sum_sqr_shift.c
    src/lib/opus-1.2.1/table_LSF_cos.c
    src/lib/opus-1.2.1/tables_LTP.c
    src/lib/opus-1.2.1/tables_NLSF_CB_NB_MB.c
    src/lib/opus-1.2.1/tables_NLSF_CB_WB.c
    src/lib/opus-1.2.1/tables_gain.c
    src/lib/opus-1.2.1/tables_other.c
    src/lib/opus-1.2.1/tables_pitch_lag.c
    src/lib/opus-1.2.1/tables_pulses_per_block.c
    src/lib/opus-1.2.1/vector_ops_FIX.c
    src/lib/opus-1.2.1/vq.c
    src/lib/opus-1.2.1/warped_autocorrelation_FIX.c
    src/lib/opus-1.2.1/arm/celt_pitch_xcorr_arm_gcc.s
)

set(CMAKE_C_FLAGS "${CMAKE_C_FLAGS} -DARM_MATH_CM4")
# set(CMAKE_C_FLAGS "${CMAKE_C_FLAGS} -DVAR_ARRAYS")
set(CMAKE_C_FLAGS "${CMAKE_C_FLAGS} -DOPUS_ARM_ASM")
set(CMAKE_C_FLAGS "${CMAKE_C_FLAGS} -DOPUS_ARM_INLINE_ASM")
set(CMAKE_C_FLAGS "${CMAKE_C_FLAGS} -DOPUS_ARM_INLINE_EDSP")
set(CMAKE_C_FLAGS "${CMAKE_C_FLAGS} -DOPUS_ARM_INLINE_MEDIA")
set(CMAKE_C_FLAGS "${CMAKE_C_FLAGS} -DOPUS_ARM_MAY_HAVE_EDSP")
set(CMAKE_C_FLAGS "${CMAKE_C_FLAGS} -DOPUS_ARM_PRESUME_EDSP")
set(CMAKE_C_FLAGS "${CMAKE_C_FLAGS} -DOPUS_BUILD")
set(CMAKE_C_FLAGS "${CMAKE_C_FLAGS} -DUSE_ALLOCA")
set(CMAKE_C_FLAGS "${CMAKE_C_FLAGS} -DFIXED_POINT -DDISABLE_FLOAT_API")
set(CMAKE_C_FLAGS "${CMAKE_C_FLAGS} -DHAVE_CONFIG_H")
set(CMAKE_C_FLAGS "${CMAKE_C_FLAGS} -DHAVE_ALLOCA_H")
set(CMAKE_C_FLAGS "${CMAKE_C_FLAGS} -fsingle-precision-constant") # A lot of constants are written as doubles
set(CMAKE_C_FLAGS "${CMAKE_C_FLAGS} -DHAVE_LRINT -DHAVE_LRINTF")
```

## Kconfig
```
source "Kconfig.zephyr"

menu "KelvinLee Features Configuration"

config KELVINLEE_CODEC_OPUS
    bool "Opus Audio Codec"
    help
        "Enable the Opus audio codec support."
    default n

config KELVINLEE_ENABLE_OFFLINE_STORAGE
	bool "Offline SD Card Storage"
    select DISK_ACCESS
    select FILE_SYSTEM
    select FAT_FILESYSTEM_ELM
    select FS_FATFS_MOUNT_MKFS
    select FS_FATFS_EXFAT
    help
        "Enable the offline storage support. Requires a SD Card."
	default n

config KELVINLEE_ENABLE_ACCELEROMETER
    bool "Accelerometer Support"
    help
        "Enable the accelerometer support."
    default n

config KELVINLEE_ENABLE_BUTTON
    bool "Button support"
    help
        "Enable the software button support."
    default n

config KELVINLEE_ENABLE_BATTERY
    bool "Enable the battery"
    help
        "Enable the battery support."
    default n

config KELVINLEE_ENABLE_USB
    bool "Enable the usb"
    help
        "Enable the USB power check support."
    default n

config KELVINLEE_ENABLE_HAPTIC
    bool "Enable the haptic"
    help
        "Enable the haptic support."
    default n

endmenu
```

## prj.conf
```kconfig
# Copyright (c) 2025-2026 Kelvin Lee. Licensed under MIT. Portions (c) 2024 Based Hardware Contributors, MIT (see LICENSE-UPSTREAM).

#
# Hardware settings
#

CONFIG_GPIO=y
CONFIG_NRFX_PDM0=y
CONFIG_ADC=y

# To flash via dev board
#CONFIG_BUILD_OUTPUT_UF2=n
#CONFIG_USE_DT_CODE_PARTITION=n

#
# Bluetooth settings
#

CONFIG_BT=y
CONFIG_BT_PERIPHERAL=y
CONFIG_BT_DEVICE_NAME="KelvinLee DevKit 2"
CONFIG_BT_MAX_CONN=1
# CONFIG_BT_EXT_ADV_MAX_ADV_SET=2
CONFIG_BT_MAX_PAIRED=1
CONFIG_BT_DEVICE_APPEARANCE=22
CONFIG_BT_GATT_DYNAMIC_DB=y

#
# Max transmit power supported by nRF52840
#

CONFIG_BT_CTLR_TX_PWR_ANTENNA=8
CONFIG_BT_PHY_UPDATE=y

#
# Battery and Device Information services
#

CONFIG_BT_BAS=y
CONFIG_BT_DIS=y
CONFIG_BT_DIS_PNP=n
CONFIG_BT_DIS_MODEL="KelvinLee DevKit 2"
CONFIG_BT_DIS_MANUF="Based Hardware"
CONFIG_BT_DIS_FW_REV=y
CONFIG_BT_DIS_HW_REV=y
CONFIG_BT_DIS_FW_REV_STR="2.0.10"
CONFIG_BT_DIS_HW_REV_STR="Seeed Xiao BLE Sense"

#
# Large BLE packets / BLE Buffers 
#
# CONFIG_BT_GATT_CLIENT=y
# CONFIG_BT_THROUGHPUT=y

CONFIG_BT_L2CAP_TX_MTU=498

CONFIG_BT_CTLR_DATA_LENGTH_MAX=251
CONFIG_BT_CTLR_PHY_2M=y
CONFIG_BT_CTLR_PHY_CODED=y
CONFIG_BT_CTLR_SDC_MAX_CONN_EVENT_LEN_DEFAULT=400000
CONFIG_BT_CONN_TX_MAX=20
CONFIG_BT_BUF_ACL_RX_SIZE=1024
CONFIG_BT_L2CAP_TX_BUF_COUNT=10
CONFIG_BT_BUF_ACL_TX_SIZE=2048
# CONFIG_BT_ATT_TX_COUNT=10
# CONFIG_BT_EXT_ADV=y
# CONFIG_BT_PER_ADV=y
# CONFIG_BT_OBSERVER=y
# CONFIG_BT_ATT_PREPARE_COUNT=2
CONFIG_BT_USER_DATA_LEN_UPDATE=y
CONFIG_BT_AUTO_DATA_LEN_UPDATE=y
CONFIG_BT_USER_PHY_UPDATE=y
CONFIG_BT_AUTO_PHY_UPDATE=y

CONFIG_FPU=y
CONFIG_NORDIC_QSPI_NOR=n
# CONFIG_BOARD_ENABLE_DCDC=y
#

#
# Console
#
# Disable the lines to enable console log
CONFIG_CONSOLE=n
CONFIG_PRINTK=n

#
# Logs
#

# Enable the lines below to enable logs via UART/USB
# CONFIG_LOG=y
# CONFIG_LOG_PRINTK=y
# CONFIG_UART_CONSOLE=y
# CONFIG_LOG_PROCESS_THREAD_PRIORITY=5
# CONFIG_LOG_PROCESS_THREAD_CUSTOM_PRIORITY=y

# Enable the lines below to enable debug logs
# Warn: Level 4 is the cause of crashing
# CONFIG_LOG_DEFAULT_LEVEL=3

#
# Log level and buffer size
#

# CONFIG_LOG_OVERRIDE_LEVEL=4
# CONFIG_LOG_BUFFER_SIZE=32000
# CONFIG_LOG_PROCESS_THREAD_STACK_SIZE=4096

#
# Debug
#

# CONFIG_DEBUG=y
# CONFIG_DEBUG_OPTIMIZATIONS=y
# CONFIG_SERIAL=y

#
# Debug (This value breaks some builds)
#

# CONFIG_ASSERT=y

#
# BT log configuration
#

# CONFIG_BT_DEBUG_LOG=y
# CONFIG_BT_L2CAP_LOG_LEVEL_DBG=y
# CONFIG_BT_LOG_LEVEL_DBG=y

# CONFIG_BT_RX_STACK_SIZE=4096
# CONFIG_BT_CTLR_RX_PRIO_STACK_SIZE=4096
# CONFIG_BT_DEBUG_LOG=y
# CONFIG_BT_RX_STACK_SIZE=4096
# CONFIG_BT_CTLR_RX_PRIO_STACK_SIZE=4096

#
# SD Card Support (all devices required)
#

CONFIG_DISK_ACCESS=y
CONFIG_FILE_SYSTEM=y
CONFIG_FAT_FILESYSTEM_ELM=y
CONFIG_FS_FATFS_MOUNT_MKFS=y
CONFIG_FS_FATFS_EXFAT=y
#nessessary?
CONFIG_MAIN_STACK_SIZE=2048
# CONFIG_DISK_DRIVER_SDMMC=y
# CONFIG_SPI=y
CONFIG_HEAP_MEM_POOL_SIZE=512

#
# Disable unused peripherals
#
CONFIG_I2C=n
# CONFIG_NRFX_TWIM0=n
# CONFIG_NRFX_TWIM1=n

#
# LSM6DSL sensor (accelerometer and gyroscope)
#
CONFIG_LSM6DSL=y
CONFIG_LSM6DSL_ENABLE_TEMP=n
# CONFIG_LSM6DSL_TRIGGER_GLOBAL_THREAD=y
CONFIG_SENSOR=y

#
# Speaker
#
CONFIG_I2S=y
CONFIG_I2S_NRFX=y
CONFIG_SPI_NRFX=y

#
# NFC (in the future)
#

# CONFIG_NFC_T2T_NRFXLIB=y
# CONFIG_NFC_NDEF=y
# CONFIG_NFC_NDEF_MSG=y
# CONFIG_NFC_NDEF_RECORD=y
# CONFIG_NFC_NDEF_URI_MSG=y
# CONFIG_NFC_NDEF_URI_REC=y
# CONFIG_HWINFO=y

#
#EVERYTHING ELSE
#

CONFIG_RING_BUFFER=y

CONFIG_PM_DEVICE=y
# CONFIG_NRFX_USBD=y

# CONFIG_FLASH=y

#
# KelvinLee features configuration
#

CONFIG_KELVINLEE_CODEC_OPUS=y
CONFIG_KELVINLEE_ENABLE_OFFLINE_STORAGE=y
CONFIG_KELVINLEE_ENABLE_ACCELEROMETER=n
CONFIG_KELVINLEE_ENABLE_BUTTON=y
CONFIG_KELVINLEE_ENABLE_BATTERY=y
CONFIG_KELVINLEE_ENABLE_USB=y
CONFIG_KELVINLEE_ENABLE_HAPTIC=y
# Copyright (c) 2025-2026 Kelvin Lee. Licensed under MIT.
#
# Wearable Kconfig delta — layered on top of prj_xiao_ble_sense_devkitv2-adafruit.conf.
# Build with:
#   west build -b xiao_ble_sense -d build_wearable -- \
#     -DCONF_FILE="prj_xiao_ble_sense_devkitv2-adafruit.conf;prj_wearable.conf" \
#     -DDTC_OVERLAY_FILE="overlay/xiao_ble_sense_devkitv2-adafruit.overlay;overlay/wearable-peripherals.overlay"

# --- NeoPixel (WS2812 via SPI1 bit-bang) ---
CONFIG_LED_STRIP=y
CONFIG_WS2812_STRIP_SPI=y

# --- PWM (haptic motor on A1/P0.03 via raw pwm_dt_spec — no led_pwm driver) ---
CONFIG_PWM=y
CONFIG_PWM_NRFX=y

# --- Input subsystem (for IoT Button on A2) ---
CONFIG_INPUT=y
CONFIG_INPUT_GPIO_KEYS=y

# --- Speaker is disabled in this build (no 5769 BFF) ---
# Overlay disables &i2s0, so CONFIG_I2S_NRFX (which requires an I2S node
# in DT) must be off. We also disable CONFIG_I2S since no I2S hardware
# remains. speaker.c::play_haptic_milli is GPIO-only, so it still builds.
CONFIG_I2S=n
CONFIG_I2S_NRFX=n

# --- Override adafruit conf's CONFIG_PRINTK=n ---
# Some logging/console dep force-selects PRINTK; aligning the requested
# value avoids a fatal Kconfig warning.
CONFIG_PRINTK=y

# --- System power management (required for sys_poweroff) ---
CONFIG_POWEROFF=y

# --- Device Information Service firmware revision ---
# Upstream DK2 v2.0.10 sets CONFIG_BT_DIS_FW_REV_STR="2.0.10"; we override it
# here so nRF Connect / any other BLE inspector can tell at a glance that a
# paired device is running the Wearable fork. Version follows the Wearable
# semver (see src/index.ts VERSION constant).
CONFIG_BT_DIS_FW_REV_STR="wearable-0.1.0+dk2-2.0.10"
CONFIG_BT_DIS_MODEL="Wearable KelvinLee DK2"
CONFIG_BT_DIS_MANUF="Kelvin Lee"
```

## prj_wearable.conf
```kconfig
# Copyright (c) 2025-2026 Kelvin Lee. Licensed under MIT.
#
# Wearable Kconfig delta — layered on top of prj_xiao_ble_sense_devkitv2-adafruit.conf.
# Build with:
#   west build -b xiao_ble_sense -d build_wearable -- \
#     -DCONF_FILE="prj_xiao_ble_sense_devkitv2-adafruit.conf;prj_wearable.conf" \
#     -DDTC_OVERLAY_FILE="overlay/xiao_ble_sense_devkitv2-adafruit.overlay;overlay/wearable-peripherals.overlay"

# --- NeoPixel (WS2812 via SPIM3 on A3) ---
# SPIM3 (0x4002F000) is the standalone SPI instance with NO TWIM sibling.
# SPIM1 shares peripheral instance 1 (0x40004000) with the board's i2c1/TWIM1
# ("Cannot be used together with spi1" — xiao_ble_common.dtsi), so enabling &spi1
# for the WS2812 collided two drivers on one block/IRQ and hard-faulted. SPIM3
# avoids that, and being pure EasyDMA (no irq_lock) it coexists with BLE — unlike
# the GPIO bit-bang driver, whose irq_lock starved the radio and killed BLE.
CONFIG_LED_STRIP=y
CONFIG_WS2812_STRIP_SPI=y
CONFIG_SPI=y
CONFIG_SPI_NRFX=y

# --- PWM (optional second haptic motor on A1) ---
CONFIG_PWM=y
CONFIG_PWM_NRFX=y

# --- Input subsystem (for IoT Button on A2) ---
CONFIG_INPUT=y
CONFIG_INPUT_GPIO_KEYS=y

# --- Speaker is disabled in this build (no 5769 BFF) ---
# Overlay disables &i2s0, so CONFIG_I2S_NRFX (which requires an I2S node
# in DT) must be off. We also disable CONFIG_I2S since no I2S hardware
# remains. speaker.c::play_haptic_milli is GPIO-only, so it still builds.
CONFIG_I2S=n
CONFIG_I2S_NRFX=n

# --- Override adafruit conf's CONFIG_PRINTK=n ---
# Some logging/console dep force-selects PRINTK; aligning the requested
# value avoids a fatal Kconfig warning.
CONFIG_PRINTK=y

# --- System power management (required for sys_poweroff) ---
CONFIG_POWEROFF=y

# --- Device Information Service firmware revision ---
# Upstream DK2 v2.0.10 sets CONFIG_BT_DIS_FW_REV_STR="2.0.10"; we override it
# here so nRF Connect / any other BLE inspector can tell at a glance that a
# paired device is running the Wearable fork. Version follows the Wearable
# semver (see src/index.ts VERSION constant).
CONFIG_BT_DIS_FW_REV_STR="wearable-0.1.0+dk2-2.0.10"
CONFIG_BT_DIS_MODEL_NUMBER_STR="wearable"
CONFIG_BT_DIS_MANUF_NAME_STR="Kelvin Lee"

# --- BLE advertised device name (what shows in LightBlue / the app scan) ---
# Dropping the "Wearable"/"KelvinLee DevKit 2" naming; the wearable now advertises as "wearable".
CONFIG_BT_DEVICE_NAME="wearable"

# Radio TX power. BT_CTLR_TX_PWR_ANTENNA is SoftDevice-Controller only
# (depends on !BT_LL_SW_SPLIT). The open link layer selects the level from
# this choice instead; +8 dBm is available because the nRF52840 sets
# HAS_HW_NRF_RADIO_TX_PWR_HIGH. Same radiated power as the NCS build.
CONFIG_BT_CTLR_TX_PWR_PLUS_8=y

# No speaker on this hardware (I2S is disabled by wearable-peripherals.overlay).
# Left =y, speaker_init() gets NULL from device_get_binding("I2S_0") and main()
# returns at that point -- before transport_start(), codec and mic -- so the
# device enumerates USB and does nothing else. prj_wearable_bare_xiao.conf,
# _phase2 and _phase3_sd already set this; prj_wearable.conf did not, so the
# documented devkitv2-adafruit build produced a non-functional image.
```

## prj_wearable_bare_xiao.conf
```kconfig
# Copyright (c) 2025-2026 Kelvin Lee. Licensed under MIT.
#
# Bench-testing overlay — Xiao nRF52840 Sense with NO BFFs soldered yet.
# Layered AFTER prj_wearable.conf. Remove from CONF_FILE when BFFs are soldered.
#
# Build with:
#   -DCONF_FILE="prj_xiao_ble_sense_devkitv2-adafruit.conf;prj_wearable.conf;prj_wearable_bare_xiao.conf"

# No MicroSD BFF → mount_sd_card() would hard-fail main().
CONFIG_KELVINLEE_ENABLE_OFFLINE_STORAGE=n

# No battery BFF → battery_init() would hard-fail main().
CONFIG_KELVINLEE_ENABLE_BATTERY=n

# No speaker (I2S disabled in prj_wearable.conf) → speaker_init() calls
# device_get_binding("I2S_0"), gets NULL, then dereferences name → crash.

# Bench board has no BFFs — disable all peripherals that could hang on init.
# Symptom: boot LED sequence completes but no further LED activity → main is
# wedged somewhere between boot_led_sequence and set_led_blue(true).
CONFIG_KELVINLEE_ENABLE_BUTTON=n
CONFIG_KELVINLEE_ENABLE_HAPTIC=n
CONFIG_KELVINLEE_ENABLE_USB=n

# NeoPixel + IoT button + vibration PWM disabled at the DT level via
# overlay/wearable-bare-xiao.overlay (layered last). Keeping LED_STRIP/
# WS2812_STRIP_SPI enabled in the driver stack so neopixel.c compiles,
# but the strip node is status="disabled" so HAS_STRIP is 0 at file scope
# and neopixel_init takes the stub path — no blocking SPI1 write on a
# dead MOSI.
```

## prj_wearable_debug.conf
```kconfig
# Copyright (c) 2025-2026 Kelvin Lee. Licensed under MIT.
#
# !! DO NOT FLASH THIS AS-IS !!
#
# Observed twice on hardware: an image built with this config hangs during boot
# and the device never finishes enumerating over USB. Cause: CONFIG_UART_CONSOLE
# routes the console to board_cdc_acm_uart, and main.c calls LOG_PRINTK()
# throughout its init sequence. cdc_acm poll-out blocks until the ring buffer
# drains, which requires a host to have opened the port -- during early boot
# nothing has, so it spins forever. Recovery is double-tap reset and flash a
# release image; the bootloader ROM is unaffected.
#
# To make this usable, the console must not be written to before a host is
# attached: gate early output on uart_line_ctrl_get(dev, UART_LINE_CTRL_DTR),
# or move the console off CDC entirely (RTT with a debug probe, or a physical
# UART on D6/D7). Until then this file is kept for reference only.
#

CONFIG_SERIAL=y
CONFIG_CONSOLE=y
CONFIG_UART_CONSOLE=y

CONFIG_LOG=y
CONFIG_LOG_BACKEND_UART=y
CONFIG_LOG_DEFAULT_LEVEL=4

# Deferred, not immediate. Anything logged before the host opens the CDC port
# would be lost in immediate mode; deferred queues it and flushes on connect,
# so the early init sequence survives. A large buffer because the whole boot
# chain lands before anyone is listening.
CONFIG_LOG_MODE_DEFERRED=y
CONFIG_LOG_BUFFER_SIZE=8192
CONFIG_LOG_PROCESS_THREAD_STARTUP_DELAY_MS=2000

CONFIG_PRINTK=y
CONFIG_THREAD_NAME=y

# Bluetooth module logging follows CONFIG_LOG_DEFAULT_LEVEL. CONFIG_BT_DEBUG_LOG
# was removed in Zephyr 4.x in favour of per-module levels; do not re-add it.
```

## prj_wearable_phase2.conf
```kconfig
# Copyright (c) 2025-2026 Kelvin Lee. Licensed under MIT.
#
# Phase 2 bench config — IoT Button + NeoPixel BFF attached (A2 button,
# A3 NeoPixel), but NO MicroSD / battery / speaker BFF yet.
#
# Use INSTEAD OF prj_wearable_bare_xiao.conf, layered AFTER prj_wearable.conf.
# Pair with overlays devkitv2-adafruit + wearable-peripherals (and NOT the
# wearable-bare-xiao overlay), so &led_strip / &iot_button / &vibration_pwm
# stay enabled at the devicetree level.
#
# Build:
#   west build -b xiao_ble_sense -d build_phase2 --no-sysbuild -p -- \
#     -DCONF_FILE="prj_xiao_ble_sense_devkitv2-adafruit.conf;prj_wearable.conf;prj_wearable_phase2.conf" \
#     -DDTC_OVERLAY_FILE="overlay/xiao_ble_sense_devkitv2-adafruit.overlay;overlay/wearable-peripherals.overlay"

# --- Enabled for Phase 2 ---
CONFIG_KELVINLEE_ENABLE_BUTTON=y           # A2 IoT-button FSM (tap/double/triple/hold) + D5 button
CONFIG_KELVINLEE_ENABLE_HAPTIC=y           # haptic cues from button gestures (init is non-fatal if no motor)

# --- Still disabled: those BFFs are not attached yet ---
CONFIG_KELVINLEE_ENABLE_OFFLINE_STORAGE=n  # no MicroSD BFF until Phase 4
CONFIG_KELVINLEE_ENABLE_BATTERY=n          # no battery BFF (USB-powered bench)

# USB power-supply check OFF: init_usb() does usb_disable()+usb_enable(), which
# blocks/hangs main() after the boot LED sequence when the USB-CDC console is up
# (logs go to RTT, so CONFIG_UART_CONSOLE is unset -> the disable/enable path runs).
# Phase 1 (USB off) booted fully and still enumerated as ZEPHYR CDC, so off is safe.
CONFIG_KELVINLEE_ENABLE_USB=n
```

## prj_wearable_phase3_sd.conf
```kconfig
# Copyright (c) 2025-2026 Kelvin Lee. Licensed under MIT.
#
# Phase 3 bench config — IoT Button + NeoPixel BFF attached (A2 button,
# A3 NeoPixel) AND MicroSD BFF attached on SPI2 (A0 CS, D8/D9/D10 SPI).
#
# Use INSTEAD OF prj_wearable_phase2.conf, layered AFTER prj_wearable.conf.
# Pair with overlays devkitv2-adafruit + wearable-peripherals. The devkitv2
# overlay owns the SD BFF SPI2 node; wearable-peripherals owns button/NeoPixel.
#
# Build:
#   west build -b xiao_ble_sense -d build_phase3_sd --no-sysbuild -p -- \
#     -DCONF_FILE="prj_xiao_ble_sense_devkitv2-adafruit.conf;prj_wearable.conf;prj_wearable_phase3_sd.conf" \
#     -DDTC_OVERLAY_FILE="overlay/xiao_ble_sense_devkitv2-adafruit.overlay;overlay/wearable-peripherals.overlay"

# --- Attached BFFs ---
CONFIG_KELVINLEE_ENABLE_BUTTON=y
CONFIG_KELVINLEE_ENABLE_HAPTIC=y
CONFIG_KELVINLEE_ENABLE_OFFLINE_STORAGE=y

# --- MicroSD BFF support ---
CONFIG_DISK_DRIVER_SDMMC=y
CONFIG_SPI=y
CONFIG_SPI_NRFX=y
CONFIG_MAIN_STACK_SIZE=8192
CONFIG_HEAP_MEM_POOL_SIZE=4096

# --- Still absent on this bench stack ---
CONFIG_KELVINLEE_ENABLE_BATTERY=n

# USB power-supply check OFF: init_usb() can block after the boot LED sequence
# on this bench path. The app-facing BLE/audio path does not require it.
CONFIG_KELVINLEE_ENABLE_USB=n
```

## prj_xiao_ble_sense_devkitv1-spisd.conf
```kconfig
# Copyright (c) 2025-2026 Kelvin Lee. Licensed under MIT. Portions (c) 2024 Based Hardware Contributors, MIT (see LICENSE-UPSTREAM).

#
# Hardware settings
#

CONFIG_GPIO=y
CONFIG_NRFX_PDM=y
CONFIG_ADC=y

# To flash via dev board
#CONFIG_BUILD_OUTPUT_UF2=n
#CONFIG_USE_DT_CODE_PARTITION=n

#
# Bluetooth settings
#

CONFIG_BT=y
CONFIG_BT_PERIPHERAL=y
CONFIG_BT_DEVICE_NAME="Friend"
CONFIG_BT_MAX_CONN=1
CONFIG_BT_MAX_PAIRED=1
CONFIG_BT_DEVICE_APPEARANCE=22
CONFIG_BT_GATT_DYNAMIC_DB=y

# Max transmit power supported by nRF52840
CONFIG_BT_CTLR_TX_PWR_ANTENNA=8
CONFIG_BT_PHY_UPDATE=y

# CONFIG_BT_L2CAP_DYNAMIC_CHANNEL=y
# CONFIG_BT_SMP=y
# CONFIG_BT_LL_SW_SPLIT=y # Alternative implementation

# Battery and Device Information services
CONFIG_BT_BAS=y
CONFIG_BT_DIS=y
CONFIG_BT_DIS_PNP=n
CONFIG_BT_DIS_MODEL="Friend DevKit 1 SPI SD"
CONFIG_BT_DIS_MANUF="Based Hardware"
CONFIG_BT_DIS_FW_REV=y
CONFIG_BT_DIS_HW_REV=y
CONFIG_BT_DIS_FW_REV_STR="1.0.5"
CONFIG_BT_DIS_HW_REV_STR="Seeed Xiao BLE Sense"

# Large packets
CONFIG_BT_L2CAP_TX_MTU=498
CONFIG_BT_L2CAP_TX_BUF_COUNT=10
# CONFIG_BT_ATT_TX_COUNT=10
CONFIG_BT_CONN_TX_MAX=30
CONFIG_BT_BUF_ACL_RX_SIZE=2048
CONFIG_BT_BUF_ACL_TX_SIZE=2048
CONFIG_BT_CTLR_DATA_LENGTH_MAX=251

CONFIG_BT_USER_DATA_LEN_UPDATE=y
CONFIG_BT_AUTO_DATA_LEN_UPDATE=y
CONFIG_BT_USER_PHY_UPDATE=y
CONFIG_BT_AUTO_PHY_UPDATE=y

# Codecs
# CONFIG_LIBLC3=y

# Debug
# Enable the lines below to enable debug logs via UART/USB

CONFIG_DEBUG=y
CONFIG_DEBUG_OPTIMIZATIONS=y
CONFIG_LOG=y
CONFIG_LOG_PRINTK=y
CONFIG_LOG_MODE_IMMEDIATE=y
CONFIG_SERIAL=y
CONFIG_UART_CONSOLE=y
CONFIG_LOG_BACKEND_UART=y
CONFIG_LOG_DEFAULT_LEVEL=3

# Debug (This value breaks some builds)
# CONFIG_ASSERT=y

# Log Levels
# CONFIG_BT_DEBUG_LOG=y
# CONFIG_BT_L2CAP_LOG_LEVEL_DBG=y
# CONFIG_BT_LOG_LEVEL_DBG=y

# CONFIG_LOG_PROCESS_THREAD_STACK_SIZE=4096
# CONFIG_BT_RX_STACK_SIZE=4096
# CONFIG_BT_CTLR_RX_PRIO_STACK_SIZE=4096
# CONFIG_BT_DEBUG_LOG=y
# CONFIG_LOG_BUFFER_SIZE=32000
# CONFIG_LOG_OVERRIDE_LEVEL=4
# CONFIG_LOG_PROCESS_THREAD_STACK_SIZE=4096
# CONFIG_BT_RX_STACK_SIZE=4096
# CONFIG_BT_CTLR_RX_PRIO_STACK_SIZE=4096

# RTT
# CONFIG_UART_CONSOLE=n
# CONFIG_SEGGER_RTT_BUFFER_SIZE_UP=2048
# CONFIG_RTT_CONSOLE=y
# CONFIG_LOG_BACKEND_RTT=y
CONFIG_KELVINLEE_CODEC_OPUS=y

# SD Card Support
CONFIG_KELVINLEE_ENABLE_OFFLINE_STORAGE=y
CONFIG_DISK_ACCESS=y
CONFIG_FILE_SYSTEM=y
CONFIG_FAT_FILESYSTEM_ELM=y
CONFIG_FS_FATFS_MOUNT_MKFS=y
CONFIG_FS_FATFS_EXFAT=y
CONFIG_PRINTK=y
CONFIG_MAIN_STACK_SIZE=5096
CONFIG_DISK_DRIVER_SDMMC=y
CONFIG_SPI=y
CONFIG_HEAP_MEM_POOL_SIZE=3048

# Increase stack and heap sizes
CONFIG_MAIN_STACK_SIZE=8192
CONFIG_HEAP_MEM_POOL_SIZE=4096
```

## src/main.c
```c
/* Copyright (c) 2025-2026 Kelvin Lee. Licensed under MIT. Portions (c) 2024 Based Hardware Contributors, MIT (see LICENSE-UPSTREAM). */

#include <zephyr/kernel.h>
#include <zephyr/logging/log.h>

#include "agent_commands.h"
#include "button.h"
#include "codec.h"
#include "config.h"
#include "led.h"
#include "lib/battery/battery.h"
#include "mic.h"
#include "sdcard.h"
#include "haptic.h"
#include "storage.h"
#include "transport.h"
#include "usb.h"
#include "utils.h"
#define BOOT_BLINK_DURATION_MS 600
#define BOOT_PAUSE_DURATION_MS 200
#define VBUS_DETECT (1U << 20)
#define WAKEUP_DETECT (1U << 16)
LOG_MODULE_REGISTER(main, CONFIG_LOG_DEFAULT_LEVEL);

static void codec_handler(uint8_t *data, size_t len)
{
    int err = broadcast_audio_packets(data, len);
    if (err) {
        LOG_ERR("Failed to broadcast audio packets: %d", err);
    }
}

static void mic_handler(int16_t *buffer)
{
    int err = codec_receive_pcm(buffer, MIC_BUFFER_SAMPLES);
    if (err) {
        LOG_ERR("Failed to process PCM data: %d", err);
    }
}

void bt_ctlr_assert_handle(char *name, int type)
{
    LOG_INF("Bluetooth assert: %s (type %d)", name ? name : "NULL", type);
}

bool is_connected = false;
bool is_charging = false;
extern bool is_off;
extern bool usb_charge;
static void boot_led_sequence(void)
{
    // Red blink
    set_led_red(true);
    k_msleep(BOOT_BLINK_DURATION_MS);
    set_led_red(false);
    k_msleep(BOOT_PAUSE_DURATION_MS);
    // Green blink
    set_led_green(true);
    k_msleep(BOOT_BLINK_DURATION_MS);
    set_led_green(false);
    k_msleep(BOOT_PAUSE_DURATION_MS);
    // Blue blink
    set_led_blue(true);
    k_msleep(BOOT_BLINK_DURATION_MS);
    set_led_blue(false);
    k_msleep(BOOT_PAUSE_DURATION_MS);
    // All LEDs on
    set_led_red(true);
    set_led_green(true);
    set_led_blue(true);
    k_msleep(BOOT_BLINK_DURATION_MS);
    // All LEDs off
    set_led_red(false);
    set_led_green(false);
    set_led_blue(false);
}

void set_led_state()
{
    // Recording and connected state - BLUE

    if (usb_charge) {
        is_charging = !is_charging;
        if (is_charging) {
            set_led_green(true);
        } else {
            set_led_green(false);
        }
    } else {
        set_led_green(false);
    }
    if (is_off) {
        set_led_red(false);
        set_led_blue(false);
        return;
    }
    if (is_connected) {
        set_led_blue(true);
        set_led_red(false);
        return;
    }

    // Recording but lost connection - RED
    if (!is_connected) {
        set_led_red(true);
        set_led_blue(false);
        return;
    }
}

int main(void)
{
    int err;

    // Store reset reason code
    uint32_t reset_reason = NRF_POWER->RESETREAS;

    NRF_POWER->DCDCEN = 1;
    NRF_POWER->DCDCEN0 = 1;
    NRF_POWER->RESETREAS = 1;

    LOG_INF("Booting...\n");

    LOG_INF("Model: %s", CONFIG_BT_DIS_MODEL);
    LOG_INF("Firmware revision: %s", CONFIG_BT_DIS_FW_REV_STR);
    LOG_INF("Hardware revision: %s", CONFIG_BT_DIS_HW_REV_STR);

    LOG_DBG("Reset reason: %d\n", reset_reason);

    LOG_PRINTK("\n");
    LOG_INF("Initializing LEDs...\n");

    err = led_start();
    if (err) {
        LOG_WRN("LEDs unavailable (err %d); continuing", err);
    }

    // Run the boot LED sequence
    boot_led_sequence();

    // Enable battery
#ifdef CONFIG_KELVINLEE_ENABLE_BATTERY
    err = battery_init();
    if (err) {
        LOG_WRN("Battery unavailable (err %d); continuing without battery reporting", err);
    }

    err = battery_charge_start();
    if (err) {
        LOG_WRN("Battery charge start failed (err %d); continuing", err);
    }
    LOG_INF("Battery initialized");
#endif

    // Enable button
#ifdef CONFIG_KELVINLEE_ENABLE_BUTTON
    err = button_init();
    if (err) {
        LOG_WRN("Button unavailable (err %d); continuing without button input", err);
    }
    LOG_INF("Button initialized");
    activate_button_work();
#endif

    // Enable accelerometer
#ifdef CONFIG_KELVINLEE_ENABLE_ACCELEROMETER
    /* accel_start() returns 1 on success and 0 or -1 on its various failure
      * paths, so a plain `if (err)` treated success as fatal. Non-fatal either
      * way now; the accelerometer is not required for capture. */
    err = accel_start();
    if (err != 1) {
        LOG_WRN("Accelerometer unavailable (err %d); continuing", err);
    }
    LOG_INF("Accelerometer initialized");
#endif

    // Enable sdcard
#ifdef CONFIG_KELVINLEE_ENABLE_OFFLINE_STORAGE
    LOG_PRINTK("\n");
    LOG_INF("Mount SD card...\n");

    err = mount_sd_card();
    if (err) {
        LOG_WRN("SD card unavailable (err %d); continuing without offline storage", err);
    } else {
        k_msleep(500);

        LOG_PRINTK("\n");
        LOG_INF("Initializing storage...\n");

        err = storage_init();
        if (err) {
            LOG_ERR("Failed to initialize storage (err %d)", err);
        }
    }
#endif

    // Enable haptic
#ifdef CONFIG_KELVINLEE_ENABLE_HAPTIC
    LOG_PRINTK("\n");
    LOG_INF("Initializing haptic...\n");

    err = init_haptic_pin();
    if (err) {
        LOG_WRN("Haptic init non-fatal (err %d) — continuing boot", err);
    } else {
        LOG_INF("Haptic pin initialized");
    }
#endif

    // Enable usb
#ifdef CONFIG_KELVINLEE_ENABLE_USB
    LOG_PRINTK("\n");
    LOG_INF("Initializing power supply check...\n");

    err = init_usb();
    if (err) {
        LOG_WRN("USB charge detect unavailable (err %d); continuing", err);
    }
#endif

    // Wearable: NeoPixel + agent-commands init is DEFERRED to after transport +
    // codec + mic (see below, just before the main loop). The blocking WS2812
    // SPI write wedged main() when run here (before transport_start), so we bring
    // it up last: BLE + button stay alive even if the SPI write stalls, and the
    // radio/HFCLK is fully up by then in case the transfer needed it.
    // (The agent-commands GATT service still self-registers at file scope via
    // BT_GATT_SERVICE_DEFINE, independent of agent_commands_init.)

    // Indicate transport initialization
    LOG_PRINTK("\n");
    LOG_INF("Initializing transport...\n");

    set_led_green(true);
    set_led_green(false);

    // Wearable diagnostic marker: visible blue pulse before transport_start
    // so we can tell whether main reaches this point (bench-testing only).
    set_led_blue(true);
    k_msleep(2000);
    set_led_blue(false);
    k_msleep(500);

    // Start transport
    int transportErr;
    transportErr = transport_start();

    // Wearable diagnostic marker: visible red pulse if transport_start
    // returned (regardless of err). Confirms we got past bt_enable etc.
    set_led_red(true);
    k_msleep(2000);
    set_led_red(false);
    k_msleep(500);
    if (transportErr) {
        LOG_ERR("Failed to start transport (err %d)", transportErr);
        // TODO: Detect the current core is app core or net core
        // Blink green LED to indicate error
        for (int i = 0; i < 5; i++) {
            set_led_green(!gpio_pin_get_dt(&led_green));
            k_msleep(200);
        }
        set_led_green(false);

        return transportErr;
    }

    LOG_PRINTK("\n");
    LOG_INF("Initializing codec...\n");

    set_led_blue(true);

    // Audio codec(opus) callback
    set_codec_callback(codec_handler);
    err = codec_start();
    if (err) {
        LOG_ERR("Failed to start codec: %d", err);
        // Blink blue LED to indicate error
        for (int i = 0; i < 5; i++) {
            set_led_blue(!gpio_pin_get_dt(&led_blue));
            k_msleep(200);
        }
        set_led_blue(false);
        return err;
    }

#ifdef CONFIG_KELVINLEE_ENABLE_HAPTIC
    play_haptic_milli(500);
#endif
    set_led_blue(false);

    // Indicate microphone initialization
    LOG_PRINTK("\n");
    LOG_INF("Initializing microphone...\n");

    set_led_red(true);
    set_led_green(true);

    set_mic_callback(mic_handler);
    err = mic_start();
    if (err) {
        LOG_ERR("Failed to start microphone: %d", err);
        // Blink red and green LEDs to indicate error
        for (int i = 0; i < 5; i++) {
            set_led_red(!gpio_pin_get_dt(&led_red));
            set_led_green(!gpio_pin_get_dt(&led_green));
            k_msleep(200);
        }
        set_led_red(false);
        set_led_green(false);
        return err;
    }

    set_led_red(false);
    set_led_green(false);

    // Wearable: NeoPixel + agent-commands init, deferred to here (after transport
    // + codec + mic) so a stalled WS2812 SPI write can't wedge boot before BLE.
#ifdef CONFIG_LED_STRIP
    LOG_PRINTK("\n");
    LOG_INF("Initializing Wearable agent commands + NeoPixel...\n");
    err = agent_commands_init();
    if (err) {
        LOG_WRN("agent_commands_init rc=%d (continuing without LED feedback)", err);
    }
#endif

    // Indicate successful initialization
    LOG_PRINTK("\n");
    LOG_INF("Device initialized successfully\n");

    set_led_blue(true);
    k_msleep(1000);
    set_led_blue(false);

    // Main loop
    LOG_PRINTK("\n");
    LOG_INF("Entering main loop...\n");

    while (1) {
        set_led_state();
        k_msleep(500);
    }

    // Unreachable
    return 0;
}
```

## src/agent_commands.c
```c
/* Copyright (c) 2025-2026 Kelvin Lee. Licensed under MIT. */

/*
 * Agent-commands GATT service for Wearable.
 *
 * Receives 4-byte command packets from the phone app (which in turn got them
 * from Wearable's src/harness/inngest/device-delivery.ts queue). Dispatches to:
 *   - neopixel.c for LED ops (colour + pattern)
 *   - haptic.c::play_haptic_milli for haptic ops
 *
 * The service is registered via BT_GATT_SERVICE_DEFINE at file scope so it
 * joins the primary advertising set automatically. transport.c doesn't need
 * any changes — Zephyr discovers the extra service at bt_enable time.
 */

#include "agent_commands.h"
#include "button.h"
#include "habitat.h"
#include "neopixel.h"
#include "haptic.h"

#include <zephyr/bluetooth/bluetooth.h>
#include <zephyr/bluetooth/gatt.h>
#include <zephyr/bluetooth/uuid.h>
#include <zephyr/kernel.h>
#include <zephyr/logging/log.h>

LOG_MODULE_REGISTER(agent_commands, CONFIG_LOG_DEFAULT_LEVEL);

/* Service base UUID — separate from the existing 0x19B10000 BLE audio
 * service. Keeps this a distinct advertised GATT service so the phone can
 * subscribe without disturbing audio streaming. */
#define WEARABLE_CMD_SERVICE_UUID_VAL BT_UUID_128_ENCODE(0xCAB1AB90, 0x0000, 0x1000, 0x8000, 0x00805F9B34FB)
#define WEARABLE_CMD_SERVICE_UUID     BT_UUID_DECLARE_128(WEARABLE_CMD_SERVICE_UUID_VAL)

static uint16_t read_pattern_duration(const uint8_t *pkt)
{
    return ((uint16_t)pkt[2] << 8) | (uint16_t)pkt[3];
}

int agent_commands_apply(const uint8_t *pkt, uint16_t len)
{
    if (pkt == NULL || len != 4) {
        return -EINVAL;
    }
    uint8_t op = pkt[0];
    LOG_INF("agent cmd: op=0x%02x [%02x %02x %02x]", op, pkt[1], pkt[2], pkt[3]);

    switch (op) {
    case AGENT_OP_LED_COLOR:
        return neopixel_set_color(pkt[1], pkt[2], pkt[3]) < 0 ? -EIO : 0;

    case AGENT_OP_LED_PATTERN: {
        neopixel_pattern_t pattern;
        switch (pkt[1]) {
        case AGENT_PATTERN_OFF:       pattern = NEOPIXEL_OFF; break;
        case AGENT_PATTERN_SOLID:     pattern = NEOPIXEL_SOLID; break;
        case AGENT_PATTERN_BREATHING: pattern = NEOPIXEL_BREATHING; break;
        case AGENT_PATTERN_PULSE:     pattern = NEOPIXEL_PULSE; break;
        case AGENT_PATTERN_BLINK:     pattern = NEOPIXEL_BLINK; break;
        case AGENT_PATTERN_FLASH:     pattern = NEOPIXEL_FLASH; break;
        case AGENT_PATTERN_FADE:      pattern = NEOPIXEL_FADE; break;
        case AGENT_PATTERN_ALT_FLASH: pattern = NEOPIXEL_ALT_FLASH; break;
        case AGENT_PATTERN_DOUBLE_BLINK: pattern = NEOPIXEL_DOUBLE_BLINK; break;
        default:
            LOG_WRN("unknown LED pattern 0x%02x", pkt[1]);
            return -EINVAL;
        }
        /* neopixel_set_pattern returns k_work_schedule's value, which is 1 for
         * "queued" and 0 for "already queued" — both success. Returning it
         * straight made the GATT handler answer ATT_ERR_UNLIKELY to a pattern
         * write that had in fact worked. Same return-contract trap that left
         * the power-on hold unlit; normalise it here. */
        return neopixel_set_pattern(pattern, read_pattern_duration(pkt)) < 0 ? -EIO : 0;
    }

    case AGENT_OP_HAPTIC: {
        /* A named pattern runs haptic.c's sequencer, which is the only way
         * the phone can reach the felt vocabulary; the durationless
         * single-buzz form stays for callers that want an exact length. */
        switch (pkt[1]) {
        case AGENT_PATTERN_HAPTIC_SINGLE: haptic_play(HAPTIC_SINGLE); return 0;
        case AGENT_PATTERN_HAPTIC_DOUBLE: haptic_play(HAPTIC_DOUBLE); return 0;
        case AGENT_PATTERN_HAPTIC_TRIPLE: haptic_play(HAPTIC_TRIPLE); return 0;
        case AGENT_PATTERN_HAPTIC_LONG:   haptic_play(HAPTIC_LONG);   return 0;
        default:
            break;
        }
        uint16_t duration_ms = read_pattern_duration(pkt);
        if (duration_ms == 0) duration_ms = 120;  /* sensible default */
        if (duration_ms > 2000) duration_ms = 2000;  /* safety cap */
        play_haptic_milli(duration_ms);
        return 0;
    }

    case AGENT_OP_STATUS_QUERY:
        /* No immediate response; future commit can notify back on
         * 0x23BA7924 with battery + pattern state. */
        return 0;

    case AGENT_OP_NOTIFY: {
        /* op=0x05, byte 1 = tier (0=low, 1=normal, 2=high, 3=alert).
         * Map to group-E LED+haptic via habitat.c. */
        uint8_t tier_raw = pkt[1];
        notify_tier_t tier;
        switch (tier_raw) {
        case 0:  tier = NOTIFY_TIER_LOW;    break;
        case 1:  tier = NOTIFY_TIER_NORMAL; break;
        case 2:  tier = NOTIFY_TIER_HIGH;   break;
        case 3:  tier = NOTIFY_TIER_ALERT;  break;
        default:
            LOG_WRN("NOTIFY op: unknown tier 0x%02x", tier_raw);
            return -EINVAL;
        }
        habitat_notify(tier);
        return 0;
    }

    case AGENT_OP_HABITAT: {
        /* The phone names a cue; habitat.c owns what it looks and feels like.
         * Without this case every button cue in the A2 grammar is dropped on
         * the wire and the wearer gets no feedback at all. */
        switch (pkt[1]) {
        case AGENT_CUE_CAPTURE_OPEN:   habitat_capture_open();   return 0;
        case AGENT_CUE_NOTE_FILED:     habitat_note_filed();     return 0;
        case AGENT_CUE_DISCARDED:      habitat_discarded();      return 0;
        case AGENT_CUE_ACK:            habitat_ack();            return 0;
        case AGENT_CUE_NOP:            habitat_nop();            return 0;
        case AGENT_CUE_BLE_SEARCHING:  habitat_ble_searching();  return 0;
        case AGENT_CUE_BLE_CONNECTED:  habitat_ble_connected();  return 0;
        case AGENT_CUE_BLE_IDLE:       habitat_ble_idle();       return 0;
        case AGENT_CUE_BUDGET_WARN:    habitat_budget_warn();    return 0;
        case AGENT_CUE_ERROR:          habitat_error();          return 0;
        case AGENT_CUE_TASK_RUNNING:   habitat_task_running();   return 0;
        case AGENT_CUE_AWAITING_INPUT: habitat_awaiting_input(); return 0;
        default:
            LOG_WRN("unknown habitat cue 0x%02x", pkt[1]);
            return -EINVAL;
        }
    }

    default:
        LOG_WRN("unknown agent op 0x%02x", op);
        return -EINVAL;
    }
}

static ssize_t gatt_write_agent_cmd(struct bt_conn *conn,
                                    const struct bt_gatt_attr *attr,
                                    const void *buf, uint16_t len,
                                    uint16_t offset, uint8_t flags)
{
    ARG_UNUSED(conn);
    ARG_UNUSED(attr);
    ARG_UNUSED(flags);

    if (offset != 0) {
        return BT_GATT_ERR(BT_ATT_ERR_INVALID_OFFSET);
    }
    if (len != 4) {
        return BT_GATT_ERR(BT_ATT_ERR_INVALID_ATTRIBUTE_LEN);
    }
    /* Every write from the phone is the only evidence button.c has that the app
     * is alive. It disarms the 1500 ms confirmation watchdog for the gesture
     * just sent, and it is what triple-tap link recovery gates on. Without this
     * call the watchdog fired an error cue after EVERY committed gesture, and
     * triple tap always took the "app is dead" branch and dropped the link.
     * Note it before applying: a command that fails to apply still proves the
     * app is there and answering. */
    button_note_app_ack();

    int rc = agent_commands_apply((const uint8_t *)buf, len);
    if (rc != 0) {
        LOG_WRN("agent cmd rejected: rc=%d", rc);
        return BT_GATT_ERR(BT_ATT_ERR_UNLIKELY);
    }
    return len;
}

BT_GATT_SERVICE_DEFINE(wearable_cmd_svc,
    BT_GATT_PRIMARY_SERVICE(WEARABLE_CMD_SERVICE_UUID),
    BT_GATT_CHARACTERISTIC(WEARABLE_AGENT_CMD_UUID,
                           BT_GATT_CHRC_WRITE_WITHOUT_RESP | BT_GATT_CHRC_WRITE,
                           BT_GATT_PERM_WRITE,
                           NULL, gatt_write_agent_cmd, NULL),
);

int agent_commands_init(void)
{
    int rc = neopixel_init();
    if (rc != 0) {
        LOG_WRN("neopixel_init rc=%d (will run without LED feedback)", rc);
    }
    LOG_INF("Wearable agent commands service ready (UUID CAB1AB90...)");
    return 0;
}
```

## src/agent_commands.h
```c
/* Copyright (c) 2025-2026 Kelvin Lee. Licensed under MIT. */

#ifndef WEARABLE_AGENT_COMMANDS_H
#define WEARABLE_AGENT_COMMANDS_H

#include <zephyr/bluetooth/gatt.h>

/**
 * Register the Wearable agent commands GATT characteristic (UUID 0xCAB1AB97).
 *
 * Wire format matches src/harness/device/commands.ts::encodeCommand in the
 * Wearable TS backend:
 *
 *     byte 0 = op   (LED_COLOR=1, LED_PATTERN=2, HAPTIC=3, STATUS_QUERY=4)
 *     byte 1 = r  OR pattern
 *     byte 2 = g  OR duration_hi
 *     byte 3 = b  OR duration_lo   (big-endian u16 ms, 0..65535)
 *
 * The characteristic supports write-without-response — one 4-byte packet
 * per write. Larger writes are rejected with BT_GATT_ERR(BT_ATT_ERR_INVALID_ATTRIBUTE_LEN).
 */

/* 16-bit UUIDs need to be wrapped into the 128-bit base. CAB1AB97 is used
 * as the full UUID to avoid collision with Bluetooth SIG assignments. */
#define WEARABLE_AGENT_CMD_UUID_VAL BT_UUID_128_ENCODE(0xCAB1AB97, 0x0000, 0x1000, 0x8000, 0x00805F9B34FB)
#define WEARABLE_AGENT_CMD_UUID     BT_UUID_DECLARE_128(WEARABLE_AGENT_CMD_UUID_VAL)

/* Op codes — must mirror commands.ts OP enum. */
#define AGENT_OP_LED_COLOR    0x01
#define AGENT_OP_LED_PATTERN  0x02
#define AGENT_OP_HAPTIC       0x03
#define AGENT_OP_STATUS_QUERY 0x04
#define AGENT_OP_NOTIFY       0x05  /* byte 1 = notify_tier_t (0=low..3=alert) */
#define AGENT_OP_HABITAT      0x06  /* byte 1 = habitat_cue_t; firmware owns the composition */

/* Habitat cue ids — byte 1 of an AGENT_OP_HABITAT write. Must mirror the
 * HABITAT_CUE map in server-contract/src/device/commands.ts. Firmware owns the
 * colour/pattern/haptic composition for each, which is the whole point: the
 * phone names a cue, it cannot compose one that drifts from habitat.c. */
#define AGENT_CUE_CAPTURE_OPEN   0x01
#define AGENT_CUE_NOTE_FILED     0x02
#define AGENT_CUE_DISCARDED      0x03
#define AGENT_CUE_ACK            0x04
#define AGENT_CUE_NOP            0x05
#define AGENT_CUE_BLE_SEARCHING  0x06
#define AGENT_CUE_BLE_CONNECTED  0x07
#define AGENT_CUE_BLE_IDLE       0x08
#define AGENT_CUE_BUDGET_WARN    0x09
#define AGENT_CUE_ERROR          0x0A
#define AGENT_CUE_TASK_RUNNING   0x0B
#define AGENT_CUE_AWAITING_INPUT 0x0C

/* Pattern codes — must mirror commands.ts PATTERN enum. */
#define AGENT_PATTERN_OFF        0x00
#define AGENT_PATTERN_SOLID      0x01
#define AGENT_PATTERN_BREATHING  0x02
#define AGENT_PATTERN_PULSE      0x03
#define AGENT_PATTERN_BLINK      0x04
#define AGENT_PATTERN_FLASH      0x05
#define AGENT_PATTERN_FADE       0x06
#define AGENT_PATTERN_ALT_FLASH  0x07
#define AGENT_PATTERN_DOUBLE_BLINK 0x08
#define AGENT_PATTERN_HAPTIC_SINGLE  0x10
#define AGENT_PATTERN_HAPTIC_DOUBLE  0x11
#define AGENT_PATTERN_HAPTIC_TRIPLE  0x12
#define AGENT_PATTERN_HAPTIC_LONG    0x13

/** Apply a 4-byte agent-command packet. Exposed for unit testing; normal
 *  dispatch flows via the GATT write handler in the service definition. */
int agent_commands_apply(const uint8_t *pkt, uint16_t len);

/** Initialise internals (NeoPixel driver, any local state). Call once during
 *  boot, after the Bluetooth stack is up but before advertising. */
int agent_commands_init(void);

#endif /* WEARABLE_AGENT_COMMANDS_H */
```

## src/button.h
```c
/* Copyright (c) 2025-2026 Kelvin Lee. Licensed under MIT. Portions (c) 2024 Based Hardware Contributors, MIT (see LICENSE-UPSTREAM). */

#ifndef BUTTON_H
#define BUTTON_H

typedef enum { IDLE, GRACE } FSM_STATE_T;

int button_init();
void activate_button_work();
void register_button_service();
void turnoff_all();
FSM_STATE_T get_current_button_state();

void force_button_state(FSM_STATE_T state);

/* Call from the 0xCAB1AB97 write handler on every write the phone makes.
 * Disarms the gesture-confirmation watchdog and marks the app alive. */
void button_note_app_ack();

#endif
```

## src/codec.h
```c
/* Copyright (c) 2025-2026 Kelvin Lee. Licensed under MIT. Portions (c) 2024 Based Hardware Contributors, MIT (see LICENSE-UPSTREAM). */

#ifndef CODEC_H
#define CODEC_H
#include <zephyr/kernel.h>

// Callback
/** Receives one encoded Opus frame (<= CODEC_OUTPUT_MAX_BYTES). Runs on the codec thread. */
typedef void (*codec_callback)(uint8_t *data, size_t len);
void set_codec_callback(codec_callback callback);

// Integration

/** Queue @p len 16-bit PCM samples for encoding. Safe to call from an ISR. */
int codec_receive_pcm(int16_t *data, size_t len);

/**
 * @brief Initialize the Codec
 *
 * Initializes the Opus encoder and starts the encoder thread.
 *
 * @return 0 if successful, negative errno code if error
 */
int codec_start(void);

#endif
```

## src/config.h
```c
/* Copyright (c) 2025-2026 Kelvin Lee. Licensed under MIT. Portions (c) 2024 Based Hardware Contributors, MIT (see LICENSE-UPSTREAM). */

#include <haly/nrfy_gpio.h>

#define MIC_GAIN 64
#define MIC_IRQ_PRIORITY 5 // NVIC priority for PDM_IRQn, set by IRQ_DIRECT_CONNECT in mic.c
#define MIC_BUFFER_SAMPLES 1600    // 100ms
#define AUDIO_BUFFER_SAMPLES 16000 // 1s
#define NETWORK_RING_BUF_SIZE 32   // number of frames * CODEC_OUTPUT_MAX_BYTES
#define MINIMAL_PACKET_SIZE 100    // Less than that doesn't make sence to send anything at all

// PIN definitions
// https://github.com/Seeed-Studio/Adafruit_nRF52_Arduino/blob/5aa3573913449410fd60f76b75673c53855ff2ec/variants/Seeed_XIAO_nRF52840_Sense/variant.cpp#L34
#define PDM_DIN_PIN NRF_GPIO_PIN_MAP(0, 16)
#define PDM_CLK_PIN NRF_GPIO_PIN_MAP(1, 0)
#define PDM_PWR_PIN NRF_GPIO_PIN_MAP(1, 10)

// Codecs
#ifdef CONFIG_KELVINLEE_CODEC_OPUS
#define CODEC_OPUS 1
#else
#error "Enable CONFIG_KELVINLEE_CODEC_OPUS in the project .conf file"
#endif

#if CODEC_OPUS
#define CODEC_PACKAGE_SAMPLES 160
#define CODEC_OUTPUT_MAX_BYTES (CODEC_PACKAGE_SAMPLES * 2) // Let's assume that 16bit is enough
#define CODEC_OPUS_APPLICATION OPUS_APPLICATION_RESTRICTED_LOWDELAY
#define CODEC_OPUS_BITRATE 32000
#define CODEC_OPUS_VBR 1
#define CODEC_OPUS_COMPLEXITY 3
#endif

// Read by the vendored Opus build, not by us: src/lib/opus-1.2.1/config.h defines
// CONFIG_OPUS_MODE_{CELT,SILK,HYBRID} and then #includes this file, so this line is
// what compiles SILK out of the encoder. Changing it changes the size of the Opus
// encoder state -- see OPUS_ENCODER_SIZE in codec.c.
#define CONFIG_OPUS_MODE CONFIG_OPUS_MODE_CELT

// Codec IDs

#ifdef CODEC_OPUS
#define CODEC_ID 20
#endif

// Logs
// #define LOG_DISCARDED
```

## src/led.c
```c
/* Copyright (c) 2025-2026 Kelvin Lee. Licensed under MIT. Portions (c) 2024 Based Hardware Contributors, MIT (see LICENSE-UPSTREAM). */

#include "led.h"

#include <zephyr/drivers/gpio.h>
#include <zephyr/logging/log.h>

#include "utils.h"

LOG_MODULE_REGISTER(led, CONFIG_LOG_DEFAULT_LEVEL);

int led_start()
{
    // All three sit on the same GPIO controller (P0.26 / P0.30 / P0.06), so a
    // single loop is enough: readiness is all-or-nothing.
    const struct gpio_dt_spec *const leds[] = {&led_red, &led_green, &led_blue};

    for (size_t i = 0; i < ARRAY_SIZE(leds); i++) {
        ASSERT_TRUE(gpio_is_ready_dt(leds[i]));
        ASSERT_OK(gpio_pin_configure_dt(leds[i], GPIO_OUTPUT_INACTIVE));
    }

    LOG_INF("LEDs started");
    return 0;
}

void set_led_red(bool on)
{
    gpio_pin_set_dt(&led_red, on);
}

void set_led_green(bool on)
{
    gpio_pin_set_dt(&led_green, on);
}

void set_led_blue(bool on)
{
    gpio_pin_set_dt(&led_blue, on);
}
```
